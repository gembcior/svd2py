# TEST_NAME register map
Vendor: TEST_VENDOR; Series: TEST_SERIES; File version: 1.1
Test svd file
CPU: TEST_CPU_NAME r1p2, little endian, MPU, FPU, double-precision FPU, I-cache, D-cache, 4 interrupt priority bits, 9 interrupts
Registers are 32-bit, read-write, reset 0x0 unless marked. A register's access mark holds for its fields unless they carry their own. Offsets are from the block's base; lines under a group give offsets from that group; [hi:lo] are bit positions; {n}, {i} and the like mark numbered series; 'fields as' and 'values as' point back to an identical list; <NAME> marks a mode.

## Memory map
0x40002000 TestPeripheral1 size 0x400 — Test peripheral number 1
0x40004000 TestPeripheral1_Derived size 0x400

## Interrupts
34 TEST0_INT (TestPeripheral1)
35 TEST1_INT (TestPeripheral1)

## TestPeripheral1 — Test peripheral number 1
Base 0x40002000; register names take the prefix prefix; register names take the suffix suffix
Same registers: TestPeripheral1_Derived 0x40004000
0x0C TEST_MODEA read-clears write-as-read — In mode A this register acts as a reload value

## Licence text in the file
MIT License
