# TEST_NAME register map
Vendor: TEST_VENDOR; Series: TEST_SERIES; File version: 1.1
Test svd file
CPU: TEST_CPU_NAME r1p2, little endian, MPU, FPU, double-precision FPU, I-cache, D-cache, 4 interrupt priority bits, 9 interrupts
Registers are 32-bit, read-write, reset 0x0 unless marked. A register's access mark holds for its fields unless they carry their own. Offsets are from the block's base; lines under a group give offsets from that group; [hi:lo] are bit positions; {n}, {i} and the like mark numbered series; 'fields as' and 'values as' point back to an identical list; <NAME> marks a mode.

## Memory map
0x40002000 TestPeripheral1 size 0x400 — Test peripheral number 1
0x40002000 TestPeripheral1_Alt — Alternate Test peripheral number 1

## Interrupts
34 TEST0_INT (TestPeripheral1)
35 TEST1_INT (TestPeripheral1)

## TestPeripheral1 — Test peripheral number 1
Base 0x40002000; register names take the prefix prefix; register names take the suffix suffix
0x0C TEST_MODEA read-clears write-as-read — In mode A this register acts as a reload value
0x0C TEST_MODEA_Alt read-clears range 2..4 (alternate view of TEST_MODEA) — In mode A this register acts as a reload value
0x12C TEST_MODEB wo read-clears — Test register modeb

## TestPeripheral1_Alt — Alternate Test peripheral number 1
Base 0x40002000; alternate view of TestPeripheral1
0x0C TEST_MODEA write-as-read — In mode A this register acts as a reload value
  [3:1] TestSetField write-1-sets read-clears range 0..5 — Test description
  [3:1] TestSetField — Test description
    0=disabled (The clock source clk0 is turned off.); 1=enabled (The clock source clk1 is running.)

## Licence text in the file
MIT License
